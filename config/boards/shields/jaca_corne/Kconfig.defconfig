## config/boards/shields/jaca_corne/Kconfig.defconfig
```kconfig
if SHIELD_JACA_CORNE_LEFT

config ZMK_KEYBOARD_NAME
    default "jaca_corne Left"

config ZMK_SPLIT_BLE_ROLE_CENTRAL
    default y

endif

if SHIELD_JACA_CORNE_RIGHT

config ZMK_KEYBOARD_NAME
    default "jaca_corne Right"

endif

if SHIELD_JACA_CORNE_LEFT || SHIELD_JACA_CORNE_RIGHT

config ZMK_SPLIT
    default y

endif
```
